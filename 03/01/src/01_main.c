//=========================================================
// src/01_main.c: generated by Hardware Configurator
//
// This file will be updated when saving a document.
// leave the sections inside the "$[...]" comment tags alone
// or they will be overwritten!!
//=========================================================

//-----------------------------------------------------------------------------
// Includes
//-----------------------------------------------------------------------------
#include <SI_EFM8BB1_Register_Enums.h>                  // SFR declarations
#include "InitDevice.h"
#include "ButtonModes.h"
#include "IncludesBasics.h"

extern uint8_t rattle_counter;
volatile char delayer = 0;

BTN_MODE BTN0_mode = BTN0_MODE_5HZ;

// $[Generated Includes]
// [Generated Includes]$

//-----------------------------------------------------------------------------
// SiLabs_Startup() Routine
// ----------------------------------------------------------------------------
// This function is called immediately after reset, before the initialization
// code is run in SILABS_STARTUP.A51 (which runs before main() ). This is a
// useful place to disable the watchdog timer, which is enable by default
// and may trigger before main() in some instances.
//-----------------------------------------------------------------------------
void SiLabs_Startup (void)
{
  // $[SiLabs Startup]
  // [SiLabs Startup]$
}

//-----------------------------------------------------------------------------
// main() Routine
// ----------------------------------------------------------------------------
int main (void)
{
  uint8_t rattle_counter_ticks = RATTLE_COUNTER_5HZ;

  // Call hardware initialization routine
  enter_DefaultMode_from_RESET();

  while (1) 
  {
    // $[Generated Run-time code]
    // [Generated Run-time code]$

    // Perrgésmentesítés és timer reload freq. változtatás.
    if(BTN0 == ON) {
        rattle_counter = 0;
        while(rattle_counter <= rattle_counter_ticks);
        if (BTN0_mode == BTN0_MODE_100HZ) BTN0_mode = BTN0_MODE_5HZ;
        else BTN0_mode++;
        BTN0_set_TIMER01_0_TH0_val(BTN0_mode);
        while(BTN0 == ON);
        while(rattle_counter < rattle_counter_ticks);
    }

    // Perrgésmentesítési idő megváltoztatása.
    switch (BTN0_mode) {
      case BTN0_MODE_5HZ:
        rattle_counter_ticks = RATTLE_COUNTER_5HZ;
        break;

      case BTN0_MODE_20HZ:
        rattle_counter_ticks = RATTLE_COUNTER_20HZ;
        break;

      case BTN0_MODE_100HZ:
        rattle_counter_ticks = RATTLE_COUNTER_100HZ;
        break;

    }
  }                             
}
