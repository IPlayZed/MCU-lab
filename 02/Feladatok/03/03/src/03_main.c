//=========================================================
// src/03_main.c: generated by Hardware Configurator
//
// This file will be updated when saving a document.
// leave the sections inside the "$[...]" comment tags alone
// or they will be overwritten!!
//=========================================================

//-----------------------------------------------------------------------------
// Includes
//-----------------------------------------------------------------------------
#include <SI_C8051F850_Register_Enums.h>                  // SFR declarations
#include "InitDevice.h"
// $[Generated Includes]
// [Generated Includes]$

typedef uint8_t U8;

#define LED0 P1_B0
#define BTN0 P1_B7

#define ON 0
#define OFF 1

extern U8 counter;
//-----------------------------------------------------------------------------
// SiLabs_Startup() Routine
// ----------------------------------------------------------------------------
// This function is called immediately after reset, before the initialization
// code is run in SILABS_STARTUP.A51 (which runs before main() ). This is a
// useful place to disable the watchdog timer, which is enable by default
// and may trigger before main() in some instances.
//-----------------------------------------------------------------------------
void SiLabs_Startup (void)
{
  // $[SiLabs Startup]
  // [SiLabs Startup]$
}
//-----------------------------------------------------------------------------
// main() Routine
// ----------------------------------------------------------------------------
int main (void)
{
  // Call hardware initialization routine
  enter_DefaultMode_from_RESET();
  while (1) 
  {
    // $[Generated Run-time code]
    // [Generated Run-time code]$
    if (BTN0 == ON) {
        counter = 0;
        while(counter <  6); // lenyomás perrgésmentesítése
        LED0 = !LED0;
        while(BTN0 == ON); // várunk, amíg le van nyomva
        counter = 0;
        while(counter <  6); // felengedés perrgésmentesítése
    }
  }                             
}
