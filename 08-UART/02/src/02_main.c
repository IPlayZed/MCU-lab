//=========================================================
// src/02_main.c: generated by Hardware Configurator
//
// This file will be updated when saving a document.
// leave the sections inside the "$[...]" comment tags alone
// or they will be overwritten!!
//=========================================================

//-----------------------------------------------------------------------------
// Includes
//-----------------------------------------------------------------------------
#include <SI_EFM8BB1_Register_Enums.h>                  // SFR declarations
#include "InitDevice.h"
// $[Generated Includes]
// [Generated Includes]$

#define BTN_PRESSED 0
#define BTN0 P0_B2
#define LED0 P1_B4
#define ON 1
#define LED_ON 0
#define LED_OFF 1

volatile uint8_t UART_data_RX;
volatile uint8_t UART_data_TX;


//-----------------------------------------------------------------------------
// SiLabs_Startup() Routine
// ----------------------------------------------------------------------------
// This function is called immediately after reset, before the initialization
// code is run in SILABS_STARTUP.A51 (which runs before main() ). This is a
// useful place to disable the watchdog timer, which is enable by default
// and may trigger before main() in some instances.
//-----------------------------------------------------------------------------
void SiLabs_Startup (void)
{
  // $[SiLabs Startup]
  // [SiLabs Startup]$
}

//-----------------------------------------------------------------------------
// main() Routine
// ----------------------------------------------------------------------------
int main (void)
{
  // Call hardware initialization routine
  enter_DefaultMode_from_RESET();
  
  SCON0_TI = ON;

  while (1) 
  {
    // $[Generated Run-time code]
    // [Generated Run-time code]$
    if(BTN0 == BTN_PRESSED) {
        UART_data_TX = 'L';
    }
    if(BTN0 != BTN_PRESSED) {
        UART_data_TX = 'o';
    }
    if(UART_data_RX == 'o') {
        LED0 = LED_ON;
    }
    if(UART_data_RX == 'L') {
        LED0 = LED_OFF;
    }
  }                             
}
