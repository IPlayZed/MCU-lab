//=========================================================
// src/01_main.c: generated by Hardware Configurator
//
// This file will be updated when saving a document.
// leave the sections inside the "$[...]" comment tags alone
// or they will be overwritten!!
//=========================================================

//-----------------------------------------------------------------------------
// Includes
//-----------------------------------------------------------------------------
#include <SI_EFM8BB1_Register_Enums.h>                  // SFR declarations
#include "InitDevice.h"
// $[Generated Includes]
// [Generated Includes]$

#define OFF 0
#define ON 1
#define N_OFF !OFF
#define N_ON !ON

// DECODER defines
#define DECODER_A P1_B1
#define DECODER_B P1_B2
#define DECODER_C P0_B4

// SHIFT REGISTER defines
#define DISP_CLOCK P0_B0
#define DISP_DATA P0_B2
#define DISP_OUT_ENABLE P0_B3

uint8_t bitSelector = 0;
uint8_t NUMBERS[10] = {0x3f, 0x06, 0x5b, 0x4f, 0x66, 0x6d, 0x7d, 0x07, 0x7f, 0x6f};

void displayData (uint8_t inputData)
{
  inputData = ~inputData;
  DISP_OUT_ENABLE = ON ;
  for(bitSelector = 0; bitSelector < 8; bitSelector++)
    {
      DISP_DATA = (inputData >> (7-bitSelector)) & 1U;
      DISP_CLOCK = N_OFF;
      DISP_CLOCK = N_ON;
    }
  DISP_OUT_ENABLE = OFF;
  DISP_OUT_ENABLE = ON;
  DISP_OUT_ENABLE = OFF;
}

void decoderSelect (uint8_t A, uint8_t B, uint8_t C)
{
  DECODER_A = A & 0x01;
  DECODER_B = B & 0x01;
  DECODER_C = C & 0x01;
}

void display (uint8_t A, uint8_t B, uint8_t C, uint8_t myData)
{
  decoderSelect(A, B, C);
  displayData(myData);
  while(!TCON_TF0);
  TCON_TF0 = OFF;
}
//-----------------------------------------------------------------------------
// SiLabs_Startup() Routine
// ----------------------------------------------------------------------------
// This function is called immediately after reset, before the initialization
// code is run in SILABS_STARTUP.A51 (which runs before main() ). This is a
// useful place to disable the watchdog timer, which is enable by default
// and may trigger before main() in some instances.
//-----------------------------------------------------------------------------
void SiLabs_Startup (void)
{
  // $[SiLabs Startup]
  // [SiLabs Startup]$
}

//-----------------------------------------------------------------------------
// main() Routine
// ----------------------------------------------------------------------------
int main (void)
{
  // Call hardware initialization routine
  enter_DefaultMode_from_RESET();

  while (1) 
  {
    // $[Generated Run-time code]
    // [Generated Run-time code]$
      // Megnéztük, de nem tudtuk rájönni mi lehet a hiba, a display rossz blokkokat választott ki.
      display(0, 0, 0, NUMBERS[0]);
      display(0, 0, 1, NUMBERS[0]);
      display(0, 1, 0, NUMBERS[0]);
      display(0, 1, 1, NUMBERS[0]);
  }                             
}
